## conf/layer.conf
```bitbake
# We have a conf and classes directory, add to BBPATH
BBPATH .= ":${LAYERDIR}"

# We have recipes-* directories, add to BBFILES
BBFILES += "${LAYERDIR}/recipes-*/*/*.bb \
            ${LAYERDIR}/recipes-*/*/*.bbappend"

BBFILE_COLLECTIONS += "meta-microservicebus-intel-nuc"
BBFILE_PATTERN_meta-microservicebus-intel-nuc = "^${LAYERDIR}/"
BBFILE_PRIORITY_meta-microservicebus-intel-nuc = "6"

LAYERDEPENDS_meta-microservicebus-intel-nuc = "core"
LAYERSERIES_COMPAT_meta-microservicebus-intel-nuc = "kirkstone"
```
